## app/boards/arm/anyon_e/Kconfig.board
```kconfig
# anyon_e board configuration

# Copyright (c) 2024 Byran Huang
# SPDX-License-Identifier: MIT

config BOARD_ANYON_E
    bool "anyon_e"
    depends on SOC_NRF52840_QIAA
```

## app/boards/arm/anyon_e/Kconfig.defconfig
```kconfig
# Copyright (c) 2024 Byran Huang
# SPDX-License-Identifier: MIT

if BOARD_ANYON_E

config BOARD
    default "anyon_e"

if USB

config USB_NRFX
    default y

config USB_DEVICE_STACK
    default y

endif # USB

config BT_CTLR
    default BT

config ZMK_KEYBOARD_NAME
    default "anyon_e keyboard"

endif # BOARD_ANYON_E
```

## app/boards/arm/bluepill/Kconfig.board
```kconfig
# byran test bluepill

# Copyright (c) 2020 The ZMK Contributors
# SPDX-License-Identifier: MIT

config BOARD_BLUEPILL
	bool "bluepill"
	depends on SOC_STM32F103X8
```

## app/boards/arm/bluepill/Kconfig.defconfig
```kconfig
# keeb.io BDN9 board configuration

# Copyright (c) 2020 The ZMK Contributors
# SPDX-License-Identifier: MIT

if BOARD_BDN9

config BOARD
	default "bluepill"

config ZMK_KEYBOARD_NAME
	default "bluepill stm32"

config ZMK_USB
	default y

endif # BOARD_BDN9
```

## app/boards/arm/keychron_q11_pro/Kconfig
```kconfig
#
# Copyright (c) 2024 Byran Huang, Keychron
# SPDX-License-Identifier: MIT
#

config BOARD_ENABLE_DCDC
    bool "Enable DCDC mode"
    select SOC_DCDC_NRF52X
    default y
    depends on BOARD_KEYCHRON_Q11_PRO_LEFT || BOARD_KEYCHRON_Q11_PRO_RIGHT

config BOARD_KEYCHRON_Q11_PRO_LEFT
    bool

config BOARD_KEYCHRON_Q11_PRO_RIGHT
    bool
```

## app/boards/arm/keychron_q11_pro/Kconfig.board
```kconfig
# Copyright (c) 2024 Byran Huang, Keychron
# SPDX-License-Identifier: MIT

config BOARD_KEYCHRON_Q11_PRO_LEFT
    bool "q11 pro left"
    depends on SOC_NRF52840_QIAA

config BOARD_KEYCHRON_Q11_PRO_RIGHT
    bool "q11 pro right"
    depends on SOC_NRF52840_QIAA
```

## app/boards/arm/keychron_q11_pro/Kconfig.defconfig
```kconfig
# Electronut Labs Papyr board configuration
# SPDX-License-Identifier: MIT

if BOARD_KEYCHRON_Q11_PRO_LEFT

config ZMK_KEYBOARD_NAME
    default "Keychron Q11 Pro"

config ZMK_SPLIT_ROLE_CENTRAL
    default y

endif

if BOARD_KEYCHRON_Q11_PRO_LEFT || BOARD_KEYCHRON_Q11_PRO_RIGHT

config BOARD
    default "keychron_q11_pro"

config ZMK_SPLIT
    default y

default BT_CTLR
    default BT

if USB

config USB_NRFX
    default y

config USB_DEVICE_STACK
    default y

endif

endif
```

## app/boards/arm/keychron_q11_pro/keychron_q11_pro_defconfig
```kconfig
# SPDX-License-Identifier: MIT

CONFIG_SOC_SERIES_NRF52X=y
CONFIG_SOC_NRF52833_QIAA=y
CONFIG_BOARD_KEYCHRON_Q11_PRO=y

# Enable MPU
CONFIG_ARM_MPU=y

CONFIG_PINCTRL=y

# Control SDB pin on CKLED
CONFIG_ZMK_EXT_POWER=y

# Enable RGB Underglow
CONFIG_I2C=y
CONFIG_LED_STRIP=y

# Enable encoder
CONFIG_EC11=y
CONFIG_EC11_TRIGGER_GLOBAL_THREAD=y

CONFIG_ZMK_RGB_UNDERGLOW=y
CONFIG_CKLED2001=y
CONFIG_ZMK_RGB_UNDERGLOW_EXT_POWER=n
CONFIG_ZMK_RGB_UNDERGLOW_EFF_START=3
CONFIG_ZMK_RGB_UNDERGLOW_BRT_START=10
CONFIG_ZMK_RGB_UNDERGLOW_HUE_START=100

# enable GPIO
CONFIG_GPIO=y

CONFIG_USE_DT_CODE_PARTITION=y
CONFIG_BUILD_OUTPUT_UF2=y

CONFIG_MPU_ALLOW_FLASH_WRITE=y
CONFIG_NVS=y
CONFIG_SETTINGS_NVS=y
CONFIG_FLASH=y
CONFIG_FLASH_PAGE_LAYOUT=y
CONFIG_FLASH_MAP=y
CONFIG_CLOCK_CONTROL_NRF=y
CONFIG_CLOCK_CONTROL_NRF_K32SRC_RC=y
```

## app/boards/arm/keychron_q11_pro/keychron_q11_pro_left_defconfig
```kconfig
# Copyright (c) 2024 Byran Huang, Keychron
# SPDX-License-Identifier: MIT

CONFIG_SOC_SERIES_NRF52X=y
CONFIG_SOC_NRF52840_QIAA=y
CONFIG_BOARD_KEYCHRON_Q11_PRO_LEFT=y

CONFIG_USB_DEVICE_VID=0x3434
CONFIG_USB_DEVICE_PID=0x0CB0
CONFIG_USB_DEVICE_MANUFACTURER="Keychron"

CONFIG_KEYCHRON_CONFIG=y

# Enable ZMK USB/BLE
CONFIG_ZMK_USB=y
CONFIG_ZMK_BLE=y

# Enable sleep
CONFIG_ZMK_SLEEP=y

# Enable MPU
CONFIG_ARM_MPU=y

# Enable pinctrl
CONFIG_PINCTRL=y

# Enable I2C
CONFIG_I2C=y

# Enable encoder
CONFIG_EC11=y
CONFIG_EC11_TRIGGER_GLOBAL_THREAD=y

# Enable RGB Underglow
CONFIG_ZMK_RGB_UNDERGLOW=y
CONFIG_CKLED2001=y
CONFIG_ZMK_RGB_UNDERGLOW_EXT_POWER=n
CONFIG_ZMK_RGB_UNDERGLOW_EFF_START=0
CONFIG_ZMK_RGB_UNDERGLOW_BRT_START=10
CONFIG_ZMK_RGB_UNDERGLOW_HUE_START=100

# Enable GPIO
CONFIG_GPIO=y

# Flashing/Building Configurations
CONFIG_USE_DT_CODE_PARTITION=y
CONFIG_BUILD_OUTPUT_UF2=y

CONFIG_MPU_ALLOW_FLASH_WRITE=y
CONFIG_NVS=y
CONFIG_SETTINGS_NVS=y
CONFIG_FLASH=y
CONFIG_FLASH_PAGE_LAYOUT=y
CONFIG_FLASH_MAP=y

# Enable 32kHz crystal
# CONFIG_CLOCK_CONTROL_NRF=y
CONFIG_CLOCK_CONTROL_NRF_K32SRC_RC=y
CONFIG_CLOCK_CONTROL_NRF_K32SRC_30PPM=y
# CONFIG_CLOCK_CONTROL_NRF_K32SRC_XTAL=y

# Enable logging over USB
# CONFIG_LOG=y
# CONFIG_LOG_PROCESS_THREAD_STARTUP_DELAY_MS=2000
# CONFIG_ZMK_USB_LOGGING=y
# CONFIG_ZMK_LOG_LEVEL_DBG=y
# CONFIG_LOG_BUFFER_SIZE=20000
# CONFIG_I2C_LOG_LEVEL_DBG=y
# CONFIG_SENSOR_LOG_LEVEL_DBG=y

CONFIG_ZMK_SPLIT_BLE_CENTRAL_BATTERY_LEVEL_PROXY=y
CONFIG_ZMK_SPLIT_BLE_CENTRAL_BATTERY_LEVEL_FETCHING=y

CONFIG_BOARD_ENABLE_DCDC=y
```

## app/boards/arm/keychron_q2/Kconfig.board
```kconfig
# Keychron Q2 board configuration

# Copyright (c) 2023 The ZMK Contributors
# SPDX-License-Identifier: MIT

config BOARD_Q2TEST
    bool "Keychron Q2"
    depends on SOC_STM32L432XX
```

## app/boards/arm/keychron_q2/keychron_q2_defconfig
```kconfig
# SPDX-License-Identifier: MIT

CONFIG_SOC_SERIES_STM32L4X=y
CONFIG_SOC_STM32L432XX=y

# 80MHz system clock
CONFIG_SYS_CLOCK_HW_CYCLES_PER_SEC=80000000

# enable PINMUX
CONFIG_PINCTRL=y

# enable GPIO
CONFIG_GPIO=y

# Enable i2c
CONFIG_I2C=y

# Enable encoder
CONFIG_EC11=y
CONFIG_EC11_TRIGGER_GLOBAL_THREAD=y

# RGB
# Uncomment these to enable RGB underglow
CONFIG_CKLED2001=y
CONFIG_ZMK_RGB_UNDERGLOW=y
CONFIG_ZMK_RGB_UNDERGLOW_EXT_POWER=n
CONFIG_ZMK_RGB_UNDERGLOW_EFF_START=3
CONFIG_ZMK_RGB_UNDERGLOW_BRT_START=10
CONFIG_ZMK_RGB_UNDERGLOW_HUE_START=100

# ZMK Settings
CONFIG_ZMK_USB=y
CONFIG_ZMK_KSCAN_MATRIX_POLLING=y
CONFIG_USB_SELF_POWERED=n
CONFIG_ZMK_USB_LOGGING=y
CONFIG_ZMK_HID_REPORT_TYPE_NKRO=y

# Needed to reduce this to size that will fit on L432
CONFIG_HEAP_MEM_POOL_SIZE=1024

# clock configuration
CONFIG_CLOCK_CONTROL=y
```

## app/boards/arm/q2test/Kconfig.board
```kconfig
# Ferris board configuration

# Copyright (c) 2020 The ZMK Contributors
# SPDX-License-Identifier: MIT

config BOARD_Q2TEST
	bool "Q2 Test"
	depends on SOC_STM32L432XX
```

## app/boards/arm/q2test/Kconfig.defconfig
```kconfig
# Ferris board configuration

# Copyright (c) 2020 The ZMK Contributors
# SPDX-License-Identifier: MIT

if BOARD_Q2TEST

config BOARD
	default "q2test"

config ZMK_KEYBOARD_NAME
	default "Q2 Test"

config ZMK_USB
	default y

config ZMK_KSCAN_MATRIX_POLLING
	default y

endif # BOARD_Q2TEST
```

## app/boards/arm/q2test/q2test_defconfig
```kconfig
# SPDX-License-Identifier: MIT

CONFIG_SOC_SERIES_STM32L4X=y
CONFIG_SOC_STM32L432XX=y
# 80MHz system clock
CONFIG_SYS_CLOCK_HW_CYCLES_PER_SEC=80000000

# enable PINMUX
CONFIG_PINCTRL=y

# enable GPIO
CONFIG_GPIO=y

# Enable i2c
CONFIG_I2C=y

# ZMK Settings
CONFIG_ZMK_USB=y
CONFIG_ZMK_KSCAN_MATRIX_POLLING=y
CONFIG_USB_SELF_POWERED=n

# Needed to reduce this to size that will fit on L432
CONFIG_HEAP_MEM_POOL_SIZE=1024

# clock configuration
CONFIG_CLOCK_CONTROL=y
```
